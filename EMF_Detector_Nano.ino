#include <SPI.h>
#include <Wire.h>
#include <Adafruit_GFX.h>
#include <Adafruit_SH1106.h>
#include <SoftwareSerial.h> 
#define OLED_RESET     4
#define SCREEN_ADDRESS 0x3C


Adafruit_SH1106 display(OLED_RESET);

SoftwareSerial espLink(2, 3); // RX, TX

#define PIN_ANTENNA A0
#define CHECK_DELAY 1000
#define DISPLAY_EMF   0
#define DISPLAY_WATER 1

#define PIN_WATER A3
#define BUZZER_WATER 11
#define WATER_LOW_TH 300
#define WATER_MED_TH 600

#define lmillis() ((long)millis())
const unsigned char zmaj [] PROGMEM = {
  // 'zmaj7 60x60, 128x64px
  0xff, 0xff, 0xff, 0xff, 0xff, 0xff, 0xff, 0xff, 0xff, 0xff, 0xff, 0xff, 0xff, 0xff, 0xff, 0xff, 
  0xff, 0xff, 0xff, 0xff, 0xff, 0xff, 0xff, 0xff, 0xff, 0xff, 0xff, 0xff, 0xff, 0xff, 0xff, 0xff, 
  0xff, 0xff, 0xff, 0xff, 0xff, 0xff, 0xff, 0xff, 0xff, 0xff, 0xff, 0xff, 0xff, 0xff, 0xff, 0xff, 
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  0xff, 0xff, 0xff, 0xff, 0xff, 0xff, 0xff, 0xff, 0xff, 0xff, 0xff, 0xff, 0xff, 0xff, 0xff, 0xff
};

void setup()
{
  Serial.begin(9600);
  espLink.begin(9600);
    pinMode(PIN_ANTENNA, INPUT);
    pinMode(PIN_WATER, INPUT);
    pinMode(BUZZER_WATER, OUTPUT);
    digitalWrite(BUZZER_WATER, LOW);

    
    display.begin(SH1106_SWITCHCAPVCC, SCREEN_ADDRESS);
     display.clearDisplay();
  display.drawBitmap(0, 0,zmaj, 128, 64, WHITE); // display.drawBitmap(x position, y position, bitmap data, bitmap width, bitmap height, color)
  display.display();
  delay(2000);
  display.clearDisplay();
  display.setTextSize(2);
  display.setTextColor(WHITE);
  display.setCursor(22,10);
  display.println("mircemk");// Print text
  display.setCursor(10,40);
  display.println("EMF METER");
  display.display();
  delay(2000);
}

void showReadings(int emfValue)
{
    display.clearDisplay();   
    display.setTextSize(3);
    display.setTextColor(WHITE);
    display.setCursor(5,40);
    display.println("EMF");

    display.setCursor(70,40);
    display.println(emfValue);

    display.display();
}

void loop()
{

   static int avgValue = 0, emfValue = 0;
    static long nextCheck = 0, emfSum = 0, iterations = 0;

    static int lastWaterLevel = -1;
    int waterValue = analogRead(PIN_WATER);

    // 0 = LOW, 1 = MEDIUM, 2 = HIGH
    int waterLevel = 0;
    if (waterValue < WATER_LOW_TH) waterLevel = 0;
    else if (waterValue < WATER_MED_TH) waterLevel = 1;
    else waterLevel = 2;
    int displayMode;
    if (waterLevel == 0) {
      displayMode = DISPLAY_EMF;
    } else {
      displayMode = DISPLAY_WATER;
    }


    // Send only when level changes
    if (waterLevel != lastWaterLevel) {
      if (waterLevel == 0) espLink.println("WATER:LOW:" + String(waterValue));
      if (waterLevel == 1) espLink.println("WATER:MEDIUM:" + String(waterValue));
      if (waterLevel == 2) espLink.println("WATER:HIGH:" + String(waterValue));
      lastWaterLevel = waterLevel;
    }

    // Turn ON water buzzer only if HIGH
    digitalWrite(BUZZER_WATER, (waterLevel == 2) ? HIGH : LOW);
    // ===== END WATER SENSOR BLOCK =====

    emfValue = constrain(analogRead(PIN_ANTENNA), 0, 1023);
    // ===== WATER SENSOR BLOCK =====
    

    emfSum += emfValue;
    iterations++;

    if (lmillis() - nextCheck >= 0) {
        avgValue = emfSum / iterations;
        emfSum = 0;
        iterations = 0;
        showReadings(avgValue);
        nextCheck = lmillis() + CHECK_DELAY;
    }
    display.clearDisplay();
    display.setTextColor(WHITE);

    if (displayMode == DISPLAY_EMF) {
      // ===== EMF DISPLAY =====
      display.setTextSize(2);
      display.setCursor(0, 0);
      display.print("EMF");

      display.setTextSize(3);
      display.setCursor(0, 30);
      display.print(emfValue);

      display.drawRoundRect(0, 55, 128, 9, 2, WHITE);
      display.fillRect(2, 57, map(emfValue, 0, 1023, 0, 124), 5, WHITE);

    } else {
      // ===== WATER DISPLAY =====
      display.setTextSize(2);
      display.setCursor(0, 0);
      display.print("WATER LEVEL");

      display.setTextSize(2);
      display.setCursor(0, 30);

      if (waterLevel == 1) display.print("MEDIUM");
      else if (waterLevel == 2) display.print("HIGH");

      display.setTextSize(1);
      display.setCursor(0, 52);
      display.print("Value: ");
      display.print(waterValue);
    }

    display.display();


if (emfValue > 400 && emfValue <800) {
  tone (12,100,500);
  espLink.println("EMF:LOW:" + String(emfValue));   // <--- ADD
  }
if (emfValue > 800 && emfValue <1200) {
  tone (12,500,500);
  espLink.println("EMF:MEDIUM:" + String(emfValue));   // <--- ADD
}
if (emfValue > 1200 ) {
  tone (12,1000,500);
  espLink.println("EMF:HIGH:" + String(emfValue));   // <--- ADD
}
}
